## config/boards/shields/fine40/Kconfig.defconfig
```kconfig
if SHIELD_fine40

config ZMK_KEYBOARD_NAME
    default "fine!40"

config I2C
	default y

config SSD1306
	default y
	
config SSD1306_REVERSE_MODE
	default y

if LVGL

config LV_Z_VDB_SIZE
	default 64

config LV_Z_DPI
	default 148

config LV_Z_BITS_PER_PIXEL
	default 1

choice LV_COLOR_DEPTH
	default LV_COLOR_DEPTH_1
endchoice

endif # LVGL

endif
```
